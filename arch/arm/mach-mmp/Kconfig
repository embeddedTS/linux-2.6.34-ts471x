## arch/arm/mach-mmp/Kconfig
```kconfig
if ARCH_MMP

menu "Marvell PXA168 Processor Variants"

config CPU_PXA168_A0
	bool "PXA168 A0 Stepping"
	select CORE_DELAY
	help
	 Say 'Y' here if you want to support Marvell PXA168-based A0
	 Silicon

config CPU_PXA168_B0
	bool "PXA168 B0 Stepping"
        help
	  Say 'Y' here if you want to support Marvell PXA168-based B0
	  Silicon
endmenu

menu "Marvell PXA168/910/MMP2 Implmentations"

config MACH_TS47XX
	bool "Technologic Systems' PXA168-based ts4700 Board"
	select CPU_PXA168
	help
	  Say 'Y' here if you want to support Technologic Systems'
	  PXA168-based ts4700 Board.


config MACH_ASPENITE
	bool "Marvell's PXA168 Aspenite Development Board"
	select CPU_PXA168
	help
	  Say 'Y' here if you want to support the Marvell PXA168-based
	  Aspenite Development Board.

config MACH_ZYLONITE2
	bool "Marvell's PXA168 Zylonite2 Development Board"
	select CPU_PXA168
	help
	  Say 'Y' here if you want to support the Marvell PXA168-based
	  Zylonite2 Development Board.

config MACH_IPCAM
	bool "Marvell's PXA168 IPCAM Development Board"
	select CPU_PXA168
	help
	  Say 'Y' here if you want to support the Marvell PXA168-based
	  IPCAM Development Board.

config MACH_DKB_GENERIC
	bool "Marvell's PXA910 Generic DKB Development Board"
	select CPU_PXA910
	select CPU_PXA168
	help
	  Say 'Y' here if you want to support the Marvell PXA910-based
	  DKB Development Board.


config MACH_TTC_DKB
	bool "Marvell's PXA910 TTC_DKB Development Board"
	select CPU_PXA910
	select CPU_PXA168
	help
	  Say 'Y' here if you want to support the Marvell PXA910-based
	  TTC_DKB Development Board.

config MACH_TAVOREVB
	bool "PXA910 Evaluation Board (aka TavorEVB)"
	select CPU_PXA910
	select CPU_PXA168
	help
	  Say 'Y' here if you want to support the Marvell PXA910-based
	  TavorEVB Development Board.

config MACH_AVENGERS_LITE
	bool "Marvell's PXA168 Avengers lite Development Board"
	select CPU_PXA168
	select HAVE_PWM
	help
	  Say 'Y' here if you want to support the Marvell PXA168-based
	  Avengers lite Development Board.

config MACH_EDGE
	bool "Marvell's PXA168 Edge 2.0 Development Board"
	select CPU_PXA168
	select HAVE_PWM
	help
	  Say 'Y' here if you want to support the Marvell PXA168-based
	  Edge Development Board.

config MACH_TETON_BGA
        bool "Marvell's PXA168 Teton BGA Development Board"
        select CPU_PXA168
        help
          Say 'Y' here if you want to support the Marvell PXA168-based
          Teton BGA Development Board.

config MACH_FLINT
	bool "Marvell's Flint Development Platform"
	select CPU_MMP2
	help
	  Say 'Y' here if you want to support the Marvell MMP2-based
	  Flint Development Platform.
	  MMP2-based board can't be co-existed with PXA168-based &
	  PXA910-based development board. Since MMP2 is compatible to
	  ARMv6 architecture.

config MACH_MARVELL_JASPER
	bool "Marvell's Jasper Development Platform"
	select CPU_MMP2
	help
	  Say 'Y' here if you want to support the Marvell MMP2-base
	  Jasper Development Platform.
	  MMP2-based board can't be co-existed with PXA168-based &
	  PXA910-based development board. Since MMP2 is compatible to
	  ARMv6 architecture.
endmenu

config GLOBAL_PREEMPT_NOTIFIERS
	bool "Enable global preempt notifier"
	depends on PREEMPT_NOTIFIERS
	default y

config CPU_PXA168
	bool
	select CPU_MOHAWK
	select PREEMPT_NOTIFIERS
	help
	  Select code specific to PXA168

config CPU_PXA910
	bool
	select CPU_MOHAWK
	select PREEMPT_NOTIFIERS
	help
	  Select code specific to PXA910

config CPU_MMP2
	bool
	select CPU_V6
	select CPU_32v6K
	help
	  Select code specific to MMP2. MMP2 is ARMv6 compatible.

config PXA_32KTIMER
	bool "PXA 32K OS Timer"
	help
	  enable 32KHz OS timer for PXA168/PXA910 Processor

config TIMER_SERVICES_MMP
	bool "timer services on MMP"
	help
	  Provide high resolution timer services

endif
```

## drivers/char/icr/Kconfig
```kconfig
menu "Color Management Unit"

config PXA_ICR
	tristate "PXA ICR driver"
	default m
	help
	   Add the color management driver for PXA

endmenu
```

## drivers/media/video/cmmb/Kconfig
```kconfig
menuconfig CMMB
	tristate "China Mobile Multimedia Broadcasting"
	---help---
	  CMMB is a mobile television and multimedia standard developed
	  and specified in China by the State Administration of Radio,
	  Film, and Television (SARFT).

if CMMB

config CMMB_IF101
	tristate "CMMB Demodulator IF101 Controller support"
	depends on VIDEO_V4L2
	select SPI
	select SPI_PXA2XX
	---help---
	  This is a video4linux2 driver for the CMMB Demodulator IF101
	  controller.

config CMMB_CA
	tristate "CA drvier for CMMB module"
	---help---
	  This is the ca driver for cmmb module

endif #CMMB
```
